## drivers/flash/Kconfig.renesas_ra
```kconfig
# Renesas RA Family

# Copyright (c) 2024-2025 Renesas Electronics Corporation
# SPDX-License-Identifier: Apache-2.0

config SOC_FLASH_RENESAS_RA_HP
	bool "RA Flash HP driver"
	depends on DT_HAS_RENESAS_RA_FLASH_HP_CONTROLLER_ENABLED
	default y
	select FLASH_HAS_DRIVER_ENABLED
	select FLASH_PAGE_LAYOUT
	select FLASH_HAS_PAGE_LAYOUT
	select FLASH_HAS_EXPLICIT_ERASE
	select USE_RA_FSP_FLASH_HP
	help
	  Enable Flash High-Performance driver for RA series

if SOC_FLASH_RENESAS_RA_HP

config FLASH_RENESAS_RA_HP_BGO
	bool "Background operations feature"
	default y
	help
	  Enable Background operations (BGOs)

config FLASH_RENESAS_RA_HP_BANK_SWAP
	bool "Extended operation for code flash bank swap"
	depends on SOC_SERIES_RA6M5 || SOC_SERIES_RA4L1
	select FLASH_HAS_EX_OP
	help
	  Enable the FLASH_RA_EX_OP_BANK_SWAP extended operation, which swaps the
	  code flash bank mapped at address 0 with the other bank on the next reset.

config FLASH_RENESAS_RA_HP_CHECK_BEFORE_READING
	bool "Verify area before reading it"
	default $(dt_nodelabel_bool_prop,flash1,erase-value-undefined)
	help
	  Do a blank check flash command before reading an area.
	  This feature prevents erroneous reading. Values read from an
	  area of the data flash that has been erased but not programmed
	  are undefined.

endif # SOC_FLASH_RENESAS_RA_HP

config SOC_FLASH_RENESAS_RA_LP
	bool "RA Flash LP driver"
	depends on DT_HAS_RENESAS_RA_FLASH_LP_CONTROLLER_ENABLED
	default y
	select FLASH_HAS_DRIVER_ENABLED
	select FLASH_PAGE_LAYOUT
	select FLASH_HAS_PAGE_LAYOUT
	select FLASH_HAS_EXPLICIT_ERASE
	select USE_RA_FSP_FLASH_LP
	help
	  Enable Flash Low-Power driver for RA series

if SOC_FLASH_RENESAS_RA_LP

config FLASH_RENESAS_RA_LP_BGO
	bool "Background operations feature"
	default y
	help
	  Enable Background operations (BGOs)

endif # SOC_FLASH_RENESAS_RA_LP

config SOC_FLASH_RENESAS_RA_MRAM
	bool "RA Flash MRAM driver"
	depends on DT_HAS_RENESAS_RA_MRAM_CONTROLLER_ENABLED
	default y
	select FLASH_HAS_DRIVER_ENABLED
	select FLASH_PAGE_LAYOUT
	select FLASH_HAS_PAGE_LAYOUT
	select FLASH_HAS_NO_EXPLICIT_ERASE
	select MPU_ALLOW_FLASH_WRITE if ARM_MPU
	select USE_RA_FSP_MRAM
	help
	  Enable Flash MRAM driver for RA series
```
